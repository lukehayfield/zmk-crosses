## config/west.yml
```yaml
manifest:
  defaults:
    revision: v0.3
  remotes:
    - name: zmkfirmware
      url-base: https://github.com/zmkfirmware
    - name: lukehayfield
      url-base: https://github.com/lukehayfield
  projects:
    - name: zmk
      remote: zmkfirmware
      import: app/west.yml
    - name: gggw-zmk-keebs
      remote: Glukehayfield
      revision: main
      import: config/west.yml
  self:
    path: config
```
